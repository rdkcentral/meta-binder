## conf/layer.conf
```bitbake
# We have a conf and classes directory, add to BBPATH
BBPATH .= ":${LAYERDIR}"

# We have recipes-* directories, add to BBFILES
BBFILES += "${LAYERDIR}/recipes-*/*/*.bb \
            ${LAYERDIR}/lib*/*.bb \
            ${LAYERDIR}/aidl*/*.bb"

BBFILE_COLLECTIONS += "binder"
BBFILE_PATTERN_binder = "^${LAYERDIR}/"
BBFILE_PRIORITY_binder = "6"

LAYERDEPENDS_binder = "core"
LAYERSERIES_COMPAT_binder = "dunfell kirkstone"

RDKCENTRAL_GITHUB_ROOT ?= "git://github.com/rdkcentral"
RDKCENTRAL_GITHUB_PROTOCOL ?= "https"
RDKCENTRAL_GITHUB_SRC_URI_SUFFIX ?= "protocol=${RDKCENTRAL_GITHUB_PROTOCOL};nobranch=1"
```
